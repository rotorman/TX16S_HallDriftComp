# file: TX16S_I2C_LSM6DS33_Test.ioc
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PD12.GPIO_Label=HEARTBEAT
FATFS._USE_LFN=2
SH.FMC_A0.0=FMC_A0,12b-sda1
FATFS0.BSP.api=Unknown
PH15.GPIO_Label=SWJ
VP_ADC1_TempSens_Input.Mode=IN-TempSens
PG8.Signal=FMC_SDCLK
PG0.Signal=FMC_A10
PI15.GPIO_Label=SWAL
PK1.Signal=LTDC_G6
SH.FMC_D5_DA5.0=FMC_D5,sd-16b-d1
SH.FMC_D9_DA9.0=FMC_D9,sd-16b-d1
PJ8.GPIO_PuPd=GPIO_PULLUP
PF7.Signal=ADC3_IN5
SH.FMC_SDNWE.0=FMC_SDNWE,12b-sda1
PD7.GPIO_PuPd=GPIO_PULLUP
PH9.Signal=GPIO_Input
SH.FMC_D11_DA11.0=FMC_D11,sd-16b-d1
PJ5.Mode=RGB565
RCC.APB2TimFreq_Value=168000000
PB6.Signal=USART1_TX
PC7.Signal=GPIO_Output
PD0.Signal=FMC_D2_DA2
ADC3.ScanConvMode=DISABLE
PD8.Signal=FMC_D13_DA13
PE1.Signal=FMC_NBL1
FATFS._LFN_UNICODE=1
FATFS0.BSP.ip=GPIO
PI4.GPIO_Label=KEYrtn
PB12.GPIO_Label=SWBL
PG14.Mode=Asynchronous
LTDC.PixelFormat_L0=LTDC_PIXEL_FORMAT_RGB565
LTDC.PixelFormat_L1=LTDC_PIXEL_FORMAT_RGB565
PC4.GPIO_Label=TrimLHR
PE9.Signal=FMC_D6_DA6
SH.FMC_A2.0=FMC_A2,12b-sda1
PB1.GPIO_Label=LCDbacklight
PE4.GPIO_Label=LEDgreen
PC9.Mode=SD_4_bits_Wide_bus
PA8.Signal=GPIO_Output
SH.FMC_D1_DA1.0=FMC_D1,sd-16b-d1
PH14.GPIO_PuPd=GPIO_PULLUP
LTDC.HSync=3
PH3.GPIO_PuPd=GPIO_PULLUP
PJ14.Signal=GPIO_Input
Mcu.Package=LQFP208
PB9.Signal=I2C1_SDA
PB1.Signal=GPIO_Output
PB14.GPIO_PuPd=GPIO_PULLUP
SPI2.Mode=SPI_MODE_MASTER
PD12.Signal=GPIO_Input
ADC3.Rank-0\#ChannelRegularConversion=1
PA10.Signal=GPIO_Input
PC11.Mode=SD_4_bits_Wide_bus
RCC.APB2CLKDivider=RCC_HCLK_DIV2
LTDC.VSync=11
RCC.APB1TimFreq_Value=84000000
PD3.GPIO_PuPd=GPIO_PULLUP
PA4.GPIO_Label=Audio
PD15.Signal=FMC_D1_DA1
PJ1.GPIO_Label=PWRon
PG12.Signal=GPIO_Input
PI5.GPIO_PuPd=GPIO_PULLUP
FATFS0.BSP.STBoard=false
SH.FMC_A4.0=FMC_A4,12b-sda1
PK4.Signal=LTDC_B5
PG5.Signal=FMC_A15_BA1
PC13.Signal=GPIO_Input
SH.FMC_D10_DA10.0=FMC_D10,sd-16b-d1
FATFS0.BSP.mode=Input
PI6.GPIO_PuPd=GPIO_PULLUP
PD3.Signal=GPIO_Input
PG9.Mode=Asynchronous
PC2.Signal=ADCx_IN12
PI12.Signal=LTDC_HSYNC
PD6.Mode=Asynchronous
LTDC.ImageWidth_L1=480
PJ11.Signal=LTDC_G4
PF8.GPIO_Label=EX1
LTDC.ImageWidth_L0=480
PD10.Signal=FMC_D15_DA15
PJ6.Mode=RGB565
PJ8.GPIO_Label=TrimLSD
PJ3.Signal=LTDC_R4
PI8.GPIO_Label=KEYenter
PA8.GPIO_Label=IntModPwr
I2C1.I2C_Mode=I2C_Fast
PJ14.GPIO_PuPd=GPIO_PULLUP
PH11.GPIO_Label=ROTENCA
PB14.Signal=GPIO_Input
PA5.Signal=GPIO_Output
PC12.Mode=SD_4_bits_Wide_bus
PB13.GPIO_PuPd=GPIO_PULLUP
PI7.Signal=GPIO_Input
SH.FMC_A6.0=FMC_A6,12b-sda1
PE14.Signal=FMC_D11_DA11
PB4.GPIO_Label=TrainerDetect
PB15.GPIO_Label=SWCL
PG7.GPIO_Label=SWH
PI2.Signal=SPI2_MISO
PA1.GPIO_Label=StickLV
PF13.Signal=FMC_A7
PC7.GPIO_Label=TrainerOut
PC8.Mode=SD_4_bits_Wide_bus
PJ13.GPIO_PuPd=GPIO_PULLUP
PJ15.Mode=RGB565
ADC1.master=1
PA5.GPIO_Label=TESTPOINT
PK4.Mode=RGB565
PE5.GPIO_Label=LEDblue
PJ0.GPIO_Label=PWRswitch
PJ8.Signal=GPIO_Input
ProjectManager.HeapSize=0x200
PH6.Signal=FMC_SDNE1
NVIC.PriorityGroup=NVIC_PRIORITYGROUP_4
PI11.GPIO_Label=KEYpageprevious
PE3.Signal=GPIO_Input
PJ4.Mode=RGB565
PC15/OSC32_OUT.Signal=RCC_OSC32_OUT
PF4.Signal=FMC_A4
PD2.Signal=SDIO_CMD
FATFS0.BSP.name=Detect_SDIO
Mcu.Family=STM32F4
PK3.Signal=LTDC_B4
SPI2.VirtualNSS=VM_NSSHARD
SH.FMC_A8.0=FMC_A8,12b-sda1
PH14.Signal=GPIO_Input
PH10.Signal=GPIO_Input
SH.FMC_D14_DA14.0=FMC_D14,sd-16b-d1
PG2.Signal=GPIO_Input
PA11.Mode=Device_Only
PC14/OSC32_IN.Mode=LSE-External-Oscillator
SH.FMC_A14_BA0.0=FMC_BA0,FourSdramBanks1
SH.FMC_A11.0=FMC_A11,12b-sda1
PB13.GPIO_Label=TrimRSD
PB15.Signal=GPIO_Input
ADC3.Channel-0\#ChannelRegularConversion=ADC_CHANNEL_0
PG11.Signal=GPIO_Input
PG15.Signal=FMC_SDNCAS
PJ14.GPIO_Label=TrimLVU
PG3.GPIO_PuPd=GPIO_PULLUP
PD13.Signal=GPIO_Input
PA15.GPIO_Label=UART3Pwr
PJ2.Signal=LTDC_R3
PA7.PinState=GPIO_PIN_SET
SH.ADCx_IN3.0=ADC3_IN3,IN3
LTDC.WindowX1_L1=479
SH.FMC_NBL1.0=FMC_NBL1,Sd2ByteEnable1
LTDC.WindowX1_L0=479
PK2.Mode=RGB565
PD5.Mode=Asynchronous
ADC1.Channel-0\#ChannelRegularConversion=ADC_CHANNEL_TEMPSENSOR
RCC.HSE_VALUE=12000000
PI14.Mode=RGB565
PA6.GPIO_PuPd=GPIO_PULLUP
PF9.Mode=IN7
PH7.GPIO_Label=PCBREV1
PA14.Mode=Serial_Wire
PF11.Signal=FMC_SDNRAS
PJ7.GPIO_Label=SWDH
PI8.GPIO_PuPd=GPIO_PULLUP
PB5.Mode=SdramChipSelect2_1
PC13.GPIO_PuPd=GPIO_PULLUP
PJ12.GPIO_Label=TrimRV
PG7.GPIO_PuPd=GPIO_PULLUP
PB7.Signal=USART1_RX
PD13.GPIO_Label=TrimLSU
PA6.Signal=GPIO_Input
PB15.GPIO_PuPd=GPIO_PULLUP
USART6.VirtualMode=VM_ASYNC
PA15.Signal=GPIO_Output
PF8.Signal=ADC3_IN6
PI1.Mode=Full_Duplex_Master
SH.ADCx_IN1.0=ADC3_IN1,IN1
PG11.GPIO_Label=USBchaCtrl
FATFS._FS_RPATH=2
PC5.Signal=GPIO_Input
PD3.GPIO_Label=TrimR
PE7.Signal=FMC_D4_DA4
PD6.Signal=USART2_RX
I2C2.I2C_Mode=I2C_Fast
PE2.GPIO_Label=LEDred
PH15.GPIO_PuPd=GPIO_PULLUP
PB4.Signal=GPIO_Input
PG2.GPIO_Label=SWDL
PA3.Signal=ADCx_IN3
PK1.Mode=RGB565
PK6.Signal=LTDC_B7
SH.ADCx_IN13.0=ADC3_IN13,IN13
LTDC.WindowY1_L0=271
PG7.Signal=GPIO_Input
LTDC.WindowY1_L1=271
PH12.GPIO_Label=SWBH
PC11.Signal=SDIO_D3
PI14.Signal=LTDC_CLK
PC8.Signal=SDIO_D0
PC10.Mode=SD_4_bits_Wide_bus
PD9.Signal=FMC_D14_DA14
FATFS0.BSP.instance=PC5
PA13.Signal=SYS_JTMS-SWDIO
PA9.Mode=Activate_VBUS
ADC3.SamplingTime-0\#ChannelRegularConversion=ADC_SAMPLETIME_3CYCLES
PF6.Signal=ADC3_IN4
SH.FMC_D13_DA13.0=FMC_D13,sd-16b-d1
PH8.Signal=GPIO_Input
PB9.Mode=I2C
PF9.GPIO_Label=EX2
PA1.Signal=ADCx_IN1
PD2.Mode=SD_4_bits_Wide_bus
PK5.Mode=RGB565
board=custom
RCC.VCOOutputFreq_Value=336000000
PI9.Signal=GPIO_Output
PH4.GPIO_Label=SWEH
SH.ADCx_IN11.0=ADC3_IN11,IN11
PI4.Signal=GPIO_Input
PC1.GPIO_Label=POS6
SH.FMC_D12_DA12.0=FMC_D12,sd-16b-d1
PF1.Signal=FMC_A1
PJ0.Signal=GPIO_Input
PE0.Signal=FMC_NBL0
PE12.Signal=FMC_D9_DA9
RCC.48MHZClocksFreq_Value=48000000
RCC.SYSCLKFreq_VALUE=168000000
PJ5.Signal=LTDC_R6
RCC.HSI_VALUE=16000000
RCC.PLLQ=7
PH3.Signal=GPIO_Input
RCC.PLLM=6
RCC.PLLN=168
PH12.GPIO_PuPd=GPIO_PULLUP
ADC3.NbrOfConversionFlag=1
LTDC.ImageHeight_L0=272
LTDC.ImageHeight_L1=272
PB12.Signal=GPIO_Input
PJ13.Signal=GPIO_Input
PA3.GPIO_Label=StickRV
SH.FMC_D7_DA7.0=FMC_D7,sd-16b-d1
PK5.Signal=LTDC_B6
PJ9.Mode=RGB565
PH12.Signal=GPIO_Input
PG2.GPIO_PuPd=GPIO_PULLUP
SPI2.VirtualType=VM_MASTER
PB10.Mode=I2C
VP_FATFS_VS_SDIO.Mode=SDIO
PK0.Mode=RGB565
PG4.Signal=FMC_A14_BA0
PC12.Signal=SDIO_CK
PB14.GPIO_Label=TrimRSU
PG6.GPIO_Label=SWGH
PC6.GPIO_Label=TrainerIn
PA6.GPIO_Label=TrimLHL
PI6.GPIO_Label=KEYmdl
PB13.Signal=GPIO_Input
PG13.Signal=GPIO_Input
PE6.GPIO_Label=HAPTIC
PF6.GPIO_Label=SLIDER1
RCC.SYSCLKSource=RCC_SYSCLKSOURCE_PLLCLK
PJ10.Signal=LTDC_G3
PB11.GPIO_Speed=GPIO_SPEED_FREQ_HIGH
SH.FMC_A15_BA1.0=FMC_BA1,FourSdramBanks1
PJ13.GPIO_Label=TrimRVD
PH5.Signal=FMC_SDNWE
PD4.Signal=GPIO_Output
I2C1.DutyCycle=I2C_DUTYCYCLE_16_9
PH1/OSC_OUT.Signal=RCC_OSC_OUT
PB6.Mode=Asynchronous
PC3.Signal=ADCx_IN13
PE5.Signal=GPIO_Output
PI3.Mode=Full_Duplex_Master
PF10.GPIO_Label=TOUCH_RST
PH10.GPIO_Label=ROTENCB
FATFS0.BSP.i2caddr=0
PG6.GPIO_PuPd=GPIO_PULLUP
PK7.Mode=RGB565
PJ2.Mode=RGB565
PI6.Signal=GPIO_Input
PI3.Signal=SPI2_MOSI
SPI2.CalculateBaudRate=21.0 MBits/s
PE2.Signal=GPIO_Output
PF8.Mode=IN6
PF3.Signal=FMC_A3
PE10.Signal=FMC_D7_DA7
ADC1.SamplingTime-0\#ChannelRegularConversion=ADC_SAMPLETIME_3CYCLES
PI7.GPIO_PuPd=GPIO_PULLUP
FATFS0.BSP.solution=PC5
PJ4.Signal=LTDC_R5
PB8.GPIO_PuPdOD=GPIO_NOPULL
SH.FMC_A1.0=FMC_A1,12b-sda1
PH2.Signal=GPIO_Input
SH.FMC_SDCLK.0=FMC_SDCLK,12b-sda1
PG12.GPIO_PuPd=GPIO_PULLUP
PF14.Signal=FMC_A8
PI11.Signal=GPIO_Input
SH.FMC_D3_DA3.0=FMC_D3,sd-16b-d1
PI10.GPIO_Label=LCDnRST
PH15.Signal=GPIO_Input
ADC1.Rank-0\#ChannelRegularConversion=1
PG9.Signal=USART6_RX
PB10.GPIO_PuPdOD=GPIO_NOPULL
PB11.GPIO_PuPdOD=GPIO_NOPULL
PC6.Signal=GPIO_Input
PD7.Signal=GPIO_Input
PD1.Signal=FMC_D3_DA3
PC0.Signal=ADCx_IN10
RCC.APB1CLKDivider=RCC_HCLK_DIV4
PG13.GPIO_Label=USBchgDetect
PI2.Mode=Full_Duplex_Master
PG10.Signal=GPIO_Output
SH.FMC_A3.0=FMC_A3,12b-sda1
PJ7.Signal=GPIO_Input
PB11.Mode=I2C
SH.FMC_D15_DA15.0=FMC_D15,sd-16b-d1
PA9.Signal=USB_OTG_FS_VBUS
ADC3.NbrOfConversion=1
PB10.Signal=I2C2_SCL
FATFS.BSP.number=1
PH9.GPIO_Label=SWAH
PJ15.Signal=LTDC_B3
PI9.GPIO_Label=INTMODboot
PH6.Mode=SdramChipSelect2_1
PE15.Signal=FMC_D12_DA12
PE8.Signal=FMC_D5_DA5
PI1.Signal=SPI2_SCK
PA0/WKUP.GPIO_Label=StickLH
PA13.Mode=Serial_Wire
SH.FMC_SDNCAS.0=FMC_SDNCAS,12b-sda1
PH14.GPIO_Label=SWI
PA4.Signal=COMP_DAC1_group
PB5.Signal=FMC_SDCKE1
PD11.Signal=GPIO_Input
USART1.VirtualMode=VM_ASYNC
LTDC.Alpha_L1=255
SH.FMC_A5.0=FMC_A5,12b-sda1
LTDC.Alpha_L0=255
PA11.Signal=USB_OTG_FS_DM
PF6.Mode=IN4
PF9.Signal=ADC3_IN7
PJ10.Mode=RGB565
PB8.Mode=I2C
PC3.GPIO_Label=SLIDER2
PI4.GPIO_PuPd=GPIO_PULLUP
PJ12.GPIO_PuPd=GPIO_PULLUP
PG3.GPIO_Label=SWGL
PB0.Signal=GPIO_Output
PC1.Signal=ADCx_IN11
PH2.GPIO_Label=TOUCH_INT
PJ7.GPIO_PuPd=GPIO_PULLUP
PG10.GPIO_Label=BluetoothEn
PI12.Mode=RGB565
PK7.Signal=LTDC_DE
RCC.CortexFreq_Value=168000000
PG6.Signal=GPIO_Input
PB10.GPIO_Speed=GPIO_SPEED_FREQ_HIGH
LTDC.HBP=40
SH.ADCx_IN2.0=ADC3_IN2,IN2
PC10.Signal=SDIO_D2
SH.FMC_NBL0.0=FMC_NBL0,Sd2ByteEnable1
PC0.GPIO_Label=POT1
SH.FMC_D6_DA6.0=FMC_D6,sd-16b-d1
PA0/WKUP.Signal=ADCx_IN0
PB0.GPIO_Label=UART6pwr
PI5.GPIO_Label=KEYtelem
PC13.GPIO_Label=KEYpagenext
PB11.Signal=I2C2_SDA
ProjectManager.StackSize=0x400
PI11.GPIO_PuPd=GPIO_PULLUP
PJ6.Signal=LTDC_R7
PD11.GPIO_PuPd=GPIO_PULLUP
SH.FMC_A7.0=FMC_A7,12b-sda1
PA12.Signal=USB_OTG_FS_DP
PH0/OSC_IN.Mode=HSE-External-Oscillator
PD11.GPIO_Label=SWCH
RCC.HCLKFreq_Value=168000000
PF12.Signal=FMC_A6
PI13.Signal=LTDC_VSYNC
SH.FMC_A10.0=FMC_A10,12b-sda1
RCC.AHBFreq_Value=168000000
SH.FMC_D8_DA8.0=FMC_D8,sd-16b-d1
PI8.Signal=GPIO_Input
SH.FMC_D2_DA2.0=FMC_D2,sd-16b-d1
PH4.GPIO_PuPd=GPIO_PULLUP
PE13.Signal=FMC_D10_DA10
PF7.GPIO_Label=VBattery
PI5.Signal=GPIO_Input
PK6.Mode=RGB565
PI0.Signal=SPI2_NSS
PA10.GPIO_Label=ExtModTX
LTDC.HFP=3
SH.ADCx_IN0.0=ADC3_IN0,IN0
SH.FMC_SDNRAS.0=FMC_SDNRAS,12b-sda1
LTDC.ActiveW=480
PH1/OSC_OUT.Mode=HSE-External-Oscillator
PE4.Signal=GPIO_Output
PD7.GPIO_Label=TrimRHR
SH.FMC_D0_DA0.0=FMC_D0,sd-16b-d1
PJ9.Signal=LTDC_G2
PJ12.Signal=GPIO_Input
USART2.VirtualMode=VM_ASYNC
PC14/OSC32_IN.Signal=RCC_OSC32_IN
PI10.PinState=GPIO_PIN_SET
PH9.GPIO_PuPd=GPIO_PULLUP
PA2.GPIO_Label=StickRH
USB_OTG_FS.VirtualMode=Device_Only
SH.FMC_A9.0=FMC_A9,12b-sda1
USART6.BaudRate=115200
PJ1.Signal=GPIO_Output
SH.FMC_D4_DA4.0=FMC_D4,sd-16b-d1
RCC.PLLSAIN=50
PF5.Signal=FMC_A5
PH3.GPIO_Label=SWF
PH7.Signal=GPIO_Input
SPI2.Direction=SPI_DIRECTION_2LINES
PF0.Signal=FMC_A0
PC2.GPIO_Label=POT2
PB3.GPIO_Label=ExtModPwr
SH.COMP_DAC1_group.0=DAC_OUT1,DAC_OUT1
ADC3.DiscontinuousConvMode=DISABLE
PK2.Signal=LTDC_G7
LTDC.FBStartAdress_L0=261120
LTDC.FBStartAdress_L1=261120
PH11.Signal=GPIO_Input
PG3.Signal=GPIO_Input
PC4.GPIO_PuPd=GPIO_PULLUP
PG1.Signal=FMC_A11
PC4.Signal=GPIO_Input
PI10.Signal=GPIO_Output
PD5.Signal=USART2_TX
PJ11.Mode=RGB565
PF7.Mode=IN5
PH8.GPIO_Label=PCBREV2
SH.ADCx_IN12.0=ADC3_IN12,IN12
PH4.Signal=GPIO_Input
ProjectManager.TargetToolchain=STM32CubeIDE
LTDC.ActiveH=272
PI0.Mode=NSS_Signal_Hard_Output
PF2.Signal=FMC_A2
PE11.Signal=FMC_D8_DA8
PK0.Signal=LTDC_G5
PG14.Signal=USART6_TX
PJ3.Mode=RGB565
PH0/OSC_IN.Signal=RCC_OSC_IN
RCC.APB2Freq_Value=84000000
PD4.GPIO_Label=TelemDir
PF10.Signal=GPIO_Output
PI7.GPIO_Label=KEYsys
PD13.GPIO_PuPd=GPIO_PULLUP
PF15.Signal=FMC_A9
PE6.Signal=GPIO_Output
PI13.Mode=RGB565
Mcu.Name=STM32F429B(E-G-I)Tx
PA2.Signal=ADCx_IN2
PD14.Signal=FMC_D0_DA0
PB3.Signal=GPIO_Output
PA7.GPIO_Label=AudioMute
PA12.Mode=Device_Only
PC5.GPIO_Label=SDpresent
PC15/OSC32_OUT.Mode=LSE-External-Oscillator
PB7.Mode=Asynchronous
PA14.Signal=SYS_JTCK-SWCLK
SH.ADCx_IN10.0=ADC3_IN10,IN10
PG12.GPIO_Label=TrimLVD
PB9.GPIO_PuPdOD=GPIO_NOPULL
ADC1.NbrOfConversionFlag=1
PK3.Mode=RGB565
PI15.Signal=GPIO_Input
PB8.Signal=I2C1_SCL
PE3.GPIO_Label=SWEL
PC9.Signal=SDIO_D1
RCC.APB1Freq_Value=42000000
PJ1.PinState=GPIO_PIN_SET
PA7.Signal=GPIO_Output
PI15.GPIO_PuPd=GPIO_PULLUP

// file: Core/Src/main.c
/* USER CODE BEGIN Header */
/**
  ******************************************************************************
  * @file           : main.c
  * @brief          : Main program body
  ******************************************************************************
  * @attention
  *
  * <h2><center>&copy; Copyright (c) 2021 STMicroelectronics.
  * All rights reserved.</center></h2>
  *
  * This software component is licensed by ST under BSD 3-Clause license,
  * the "License"; You may not use this file except in compliance with the
  * License. You may obtain a copy of the License at:
  *                        opensource.org/licenses/BSD-3-Clause
  *
  ******************************************************************************
  */
/* USER CODE END Header */
#include "main.h"
#include "fatfs.h"

/* USER CODE BEGIN Includes */
#include "math.h"
/* USER CODE END Includes */

/* USER CODE BEGIN PTD */
typedef struct {
	int16_t linacc_odr;
	float linacc_mG; // milli G per Bit
	int16_t linacc_aabw;
	int16_t gyro_odr;
	float gyro_mDPS; // milli degrees per second per Bit
} sIMUsettings;

typedef struct {
	float fTemperatureDegC; //°C
	float fAccX, fAccY, fAccZ; // m/s^2
	float fGyroXradps, fGyroYradps, fGyroZradps; // rad/s
} sIMUoutput;

/* USER CODE END PTD */

/* USER CODE BEGIN PD */
//#define WITHACCGYRO
//#define WITHMINMAX

#define ADDR_TS_CAL1 ((uint16_t*) ((uint32_t) 0x1FFF7A2CUL)) /* 30 deg C calibration value @3.3V */
#define ADDR_TS_CAL2 ((uint16_t*) ((uint32_t) 0x1FFF7A2EUL)) /* 110 deg C calibration value @3.3V */

#define GRAVITY_EARTH					9.80665F	// m/s^2

#define LSM6DS33_I2C_ADDR				0x6A
#define LSM6DS33_WHOAMI					0x69
#define LSM6DS33_TIMEOUT				3 			// 3ms

// LSM6DS33 register map
#define LSM6DS33_FUNC_CFG_ACCESS_ADDR	0x01
#define LSM6DS33_FIFO_CTRL1_ADDR		0x06
#define LSM6DS33_FIFO_CTRL2_ADDR		0x07
#define LSM6DS33_FIFO_CTRL3_ADDR		0x08
#define LSM6DS33_FIFO_CTRL4_ADDR		0x09
#define LSM6DS33_FIFO_CTRL5_ADDR		0x0A
#define LSM6DS33_ORIENT_CFG_G_ADDR		0x0B
#define LSM6DS33_INT1_CTRL_ADDR			0x0D
#define LSM6DS33_INT2_CTRL_ADDR			0x0E
#define LSM6DS33_WHO_AM_I_ADDR			0x0F
#define LSM6DS33_CTRL1_XL_ADDR			0x10
#define LSM6DS33_CTRL2_G_ADDR			0x11
#define LSM6DS33_CTRL3_C_ADDR			0x12
#define LSM6DS33_CTRL4_C_ADDR			0x13
#define LSM6DS33_CTRL5_C_ADDR			0x14
#define LSM6DS33_CTRL6_C_ADDR			0x15
#define LSM6DS33_CTRL7_G_ADDR			0x16
#define LSM6DS33_CTRL8_XL_ADDR			0x17
#define LSM6DS33_CTRL9_XL_ADDR			0x18
#define LSM6DS33_CTRL10_C_ADDR			0x19
#define LSM6DS33_WAKE_UP_SRC_ADDR		0x1B
#define LSM6DS33_TAP_SRC_ADDR			0x1C
#define LSM6DS33_D6D_SRC_ADDR			0x1D
#define LSM6DS33_STATUS_REG_ADDR		0x1E
#define LSM6DS33_OUT_TEMP_L_ADDR		0x20
#define LSM6DS33_OUT_TEMP_H_ADDR		0x21
#define LSM6DS33_OUTX_L_G_ADDR			0x22
#define LSM6DS33_OUTX_H_G_ADDR			0x23
#define LSM6DS33_OUTY_L_G_ADDR			0x24
#define LSM6DS33_OUTY_H_G_ADDR			0x25
#define LSM6DS33_OUTZ_L_G_ADDR			0x26
#define LSM6DS33_OUTZ_H_G_ADDR			0x27
#define LSM6DS33_OUTX_L_XL_ADDR			0x28
#define LSM6DS33_OUTX_H_XL_ADDR			0x29
#define LSM6DS33_OUTY_L_XL_ADDR			0x2A
#define LSM6DS33_OUTY_H_XL_ADDR			0x2B
#define LSM6DS33_OUTZ_L_XL_ADDR			0x2C
#define LSM6DS33_OUTZ_H_XL_ADDR			0x2D
#define LSM6DS33_FIFO_STATUS1_ADDR		0x3A
#define LSM6DS33_FIFO_STATUS2_ADDR		0x3B
#define LSM6DS33_FIFO_STATUS3_ADDR		0x3C
#define LSM6DS33_FIFO_STATUS4_ADDR		0x3D
#define LSM6DS33_FIFO_DATA_OUT_L_ADDR	0x3E
#define LSM6DS33_FIFO_DATA_OUT_H_ADDR	0x3F
#define LSM6DS33_TIMESTAMP0_REG_ADDR	0x40
#define LSM6DS33_TIMESTAMP1_REG_ADDR	0x41
#define LSM6DS33_TIMESTAMP2_REG_ADDR	0x42
#define LSM6DS33_STEP_TIMESTAMP_L_ADDR	0x49
#define LSM6DS33_STEP_TIMESTAMP_H_ADDR	0x4A
#define LSM6DS33_STEP_COUNTER_L_ADDR	0x4B
#define LSM6DS33_STEP_COUNTER_H_ADDR	0x4C
#define LSM6DS33_FUNC_SRC_ADDR			0x53
#define LSM6DS33_TAP_CFG_ADDR			0x58
#define LSM6DS33_TAP_THS_6D_ADDR		0x59
#define LSM6DS33_INT_DUR2_ADDR			0x5A
#define LSM6DS33_WAKE_UP_THS_ADDR		0x5B
#define LSM6DS33_WAKE_UP_DUR_ADDR		0x5C
#define LSM6DS33_FREE_FALL_ADDR			0x5D
#define LSM6DS33_MD1_CFG_ADDR			0x5E
#define LSM6DS33_MD2_CFG_ADDR			0x5F

#define LSM6DS33_ODR_0Hz				0x00
#define LSM6DS33_ODR_12_5Hz				0x01
#define LSM6DS33_ODR_26Hz				0x02
#define LSM6DS33_ODR_52Hz				0x03
#define LSM6DS33_ODR_104Hz				0x04
#define LSM6DS33_ODR_208Hz				0x05
#define LSM6DS33_ODR_416Hz				0x06
#define LSM6DS33_ODR_833Hz				0x07
#define LSM6DS33_ODR_1_66kHz			0x08
#define LSM6DS33_ODR_3_33kHz			0x09
#define LSM6DS33_ODR_6_66kHz			0x0A

#define LSM6DS33_LA_FS_2G				0x00
#define LSM6DS33_LA_FS_16G				0x01
#define LSM6DS33_LA_FS_4G				0x02
#define LSM6DS33_LA_FS_8G				0x03

#define LSM6DS33_LA_AABW_400Hz			0x00
#define LSM6DS33_LA_AABW_200Hz			0x01
#define LSM6DS33_LA_AABW_100Hz			0x02
#define LSM6DS33_LA_AABW_50Hz			0x03

#define LSM6DS33_GY_FS_125dps			0x01
#define LSM6DS33_GY_FS_250dps			0x00
#define LSM6DS33_GY_FS_500dps			0x02
#define LSM6DS33_GY_FS_1000dps			0x04
#define LSM6DS33_GY_FS_2000dps			0x05
/* USER CODE END PD */

ADC_HandleTypeDef hadc1;
ADC_HandleTypeDef hadc3;

DAC_HandleTypeDef hdac;

I2C_HandleTypeDef hi2c1;
I2C_HandleTypeDef hi2c2;

LTDC_HandleTypeDef hltdc;

SD_HandleTypeDef hsd;

SPI_HandleTypeDef hspi2;

UART_HandleTypeDef huart1;
UART_HandleTypeDef huart2;
UART_HandleTypeDef huart6;

PCD_HandleTypeDef hpcd_USB_OTG_FS;

SDRAM_HandleTypeDef hsdram1;

/* USER CODE BEGIN PV */
sIMUsettings IMUsettings = {-1, -1.0, -1, -1, -1.0};

sIMUoutput IMUoutput = {0.0, 0.0, 0.0, 0.0, 0.0, 0.0, 0.0};
/* USER CODE END PV */

void SystemClock_Config(void);
static void MX_GPIO_Init(void);
static void MX_USB_OTG_FS_PCD_Init(void);
static void MX_FMC_Init(void);
static void MX_LTDC_Init(void);
static void MX_I2C1_Init(void);
static void MX_ADC3_Init(void);
static void MX_DAC_Init(void);
static void MX_SDIO_SD_Init(void);
static void MX_SPI2_Init(void);
static void MX_USART1_UART_Init(void);
static void MX_USART2_UART_Init(void);
static void MX_USART6_UART_Init(void);
static void MX_I2C2_Init(void);
static void MX_ADC1_Init(void);

/* USER CODE BEGIN 0 */
#define CRLF "\r\n"

#define PRINTF_BUFFER_SIZE    128

void serialPrintf(const char * format, ...)
{
	va_list arglist;
	char tmp[PRINTF_BUFFER_SIZE + 1];
#ifdef WITHMINMAX
	snprintf(tmp, PRINTF_BUFFER_SIZE, "%.3f;", (float)(HAL_GetTick())/1000.0);
#else
	snprintf(tmp, PRINTF_BUFFER_SIZE, "%.0f;", (float)(HAL_GetTick())/1000.0);
#endif
	va_start(arglist, format);
	vsnprintf(tmp + strlen(tmp), PRINTF_BUFFER_SIZE - strlen(tmp), format, arglist);
	tmp[PRINTF_BUFFER_SIZE] = '\0';
	va_end(arglist);

	const char *t = tmp;
	HAL_UART_Transmit(&huart6, (uint8_t *) t, strlen(t), 10);
}

#define debugPrintf(...) do { serialPrintf(__VA_ARGS__); } while(0)
#define TRACE(f_, ...)        debugPrintf((f_ CRLF), ##__VA_ARGS__)

void TOUCH_AF_INT_Change(void)
{
	GPIO_InitTypeDef GPIO_InitStructure;

	GPIO_InitStructure.Pin = TOUCH_INT_Pin;
	GPIO_InitStructure.Speed = GPIO_SPEED_HIGH;
	GPIO_InitStructure.Pull = GPIO_PULLUP;
	GPIO_InitStructure.Mode = GPIO_MODE_INPUT;
	HAL_GPIO_Init(TOUCH_INT_GPIO_Port, &GPIO_InitStructure);
}

bool I2C_LSM6DS33_ReadRegister(uint8_t reg, uint8_t * buf, uint8_t len)
{
	if (HAL_I2C_Master_Transmit(&hi2c2, LSM6DS33_I2C_ADDR << 1, &reg, 1, 10000) != HAL_OK)
	{
		TRACE("I2C ERROR: ReadRegister write reg. address failed");
		asm("bkpt 255");
		return false;
	}

	if (HAL_I2C_Master_Receive(&hi2c2, LSM6DS33_I2C_ADDR << 1, buf, len, 10000) != HAL_OK)
	{
		TRACE("I2C ERROR: ReadRegister read register failed");
		asm("bkpt 255");
		return false;
	}
	return true;
}

bool I2C_LSM6DS33_WriteRegister(uint8_t reg, uint8_t * buf, uint8_t len)
{
	uint8_t uAddrAndBuf[15];
	uAddrAndBuf[0] = reg;

	if (len > 0)
	{
		for (int i = 0;i < len;i++)
		{
			uAddrAndBuf[i + 1] = buf[i];
		}
	}

	if (HAL_I2C_Master_Transmit(&hi2c2, LSM6DS33_I2C_ADDR << 1, uAddrAndBuf, len + 1, 10000) != HAL_OK)
	{
		TRACE("I2C ERROR: WriteRegister failed");
		asm("bkpt 255");
		return false;
	}
	return true;
}

bool IMUgetConf(void)
{
	uint8_t ui8_regs[2] = {0};

	if (!I2C_LSM6DS33_ReadRegister(LSM6DS33_CTRL1_XL_ADDR, ui8_regs, 2))
	{
		TRACE("ERROR: LSM6DS33 did not respond to I2C address");
		return false;
	}

	switch ((ui8_regs[0] >> 4) & 0x0F) // CTRL1_XL
	{
		case LSM6DS33_ODR_0Hz:			IMUsettings.linacc_odr = 0; TRACE("LSM6DS33 lin. acc. output turned off"); break;
		case LSM6DS33_ODR_12_5Hz:		IMUsettings.linacc_odr = 13; break;
		case LSM6DS33_ODR_26Hz:			IMUsettings.linacc_odr = 26; break;
		case LSM6DS33_ODR_52Hz:			IMUsettings.linacc_odr = 52; break;
		case LSM6DS33_ODR_104Hz:		IMUsettings.linacc_odr = 104; break;
		case LSM6DS33_ODR_208Hz:		IMUsettings.linacc_odr = 208; break;
		case LSM6DS33_ODR_416Hz:		IMUsettings.linacc_odr = 417; break;
		case LSM6DS33_ODR_833Hz:		IMUsettings.linacc_odr = 833; break;
		case LSM6DS33_ODR_1_66kHz:		IMUsettings.linacc_odr = 1667; break;
		case LSM6DS33_ODR_3_33kHz:		IMUsettings.linacc_odr = 3333; break;
		case LSM6DS33_ODR_6_66kHz:		IMUsettings.linacc_odr = 6667; break;
		default: 						TRACE("ERROR: LSM6DS33 lin.acc. output data rate at illegal setting"); return false; break;
	}
	if (IMUsettings.linacc_odr > 0) 	TRACE("LSM6DS33 lin. acc. output at %i Hz", IMUsettings.linacc_odr);

	switch ((ui8_regs[0] >> 2) & 0x03)
	{
		case LSM6DS33_LA_FS_2G:			IMUsettings.linacc_mG = 0.061; break;
		case LSM6DS33_LA_FS_4G:			IMUsettings.linacc_mG = 0.122; break;
		case LSM6DS33_LA_FS_8G:			IMUsettings.linacc_mG = 0.244; break;
		case LSM6DS33_LA_FS_16G:		IMUsettings.linacc_mG = 0.488; break;
		default:						TRACE("ERROR: LSM6DS33 lin. acc full scale value at illegal setting"); return false; break;
	}
	TRACE("LSM6DS33 lin. acc. resolution %.2f G", IMUsettings.linacc_mG);

	switch ((ui8_regs[0] >> 2) & 0x03)
	{
		case LSM6DS33_LA_AABW_400Hz:	IMUsettings.linacc_aabw = 400; break;
		case LSM6DS33_LA_AABW_200Hz:	IMUsettings.linacc_aabw = 200; break;
		case LSM6DS33_LA_AABW_100Hz:	IMUsettings.linacc_aabw = 100; break;
		case LSM6DS33_LA_AABW_50Hz:		IMUsettings.linacc_aabw = 50; break;
		default:						TRACE("ERROR: LSM6DS33 lin. acc anti aliasing bandwidth at illegal setting"); return false; break;
	}
	TRACE("LSM6DS33 lin. acc. anti aliasing bandwidth at %i Hz", IMUsettings.linacc_aabw);

	switch ((ui8_regs[1] >> 4) & 0x0F) // CTRL2_G
	{
		case LSM6DS33_ODR_0Hz:			IMUsettings.gyro_odr = 0; TRACE("LSM6DS33 gyro output turned off"); break;
		case LSM6DS33_ODR_12_5Hz:		IMUsettings.gyro_odr = 13; break;
		case LSM6DS33_ODR_26Hz:			IMUsettings.gyro_odr = 26; break;
		case LSM6DS33_ODR_52Hz:			IMUsettings.gyro_odr = 52; break;
		case LSM6DS33_ODR_104Hz:		IMUsettings.gyro_odr = 104; break;
		case LSM6DS33_ODR_208Hz:		IMUsettings.gyro_odr = 208; break;
		case LSM6DS33_ODR_416Hz:		IMUsettings.gyro_odr = 417; break;
		case LSM6DS33_ODR_833Hz:		IMUsettings.gyro_odr = 833; break;
		case LSM6DS33_ODR_1_66kHz:		IMUsettings.gyro_odr = 1667; break;
		default: 						TRACE("ERROR: LSM6DS33 gyro output data rate at illegal setting"); return false; break;
	}
	if (IMUsettings.gyro_odr > 0) 	TRACE("LSM6DS33 gyro output at %i Hz", IMUsettings.gyro_odr);

	switch ((ui8_regs[1] >> 1) & 0x07)
	{
		case LSM6DS33_GY_FS_125dps:		IMUsettings.gyro_mDPS	= 4.375; break;
		case LSM6DS33_GY_FS_250dps:		IMUsettings.gyro_mDPS	= 8.75; break;
		case LSM6DS33_GY_FS_500dps:		IMUsettings.gyro_mDPS	= 17.5; break;
		case LSM6DS33_GY_FS_1000dps:	IMUsettings.gyro_mDPS	= 35.0; break;
		case LSM6DS33_GY_FS_2000dps:	IMUsettings.gyro_mDPS	= 70.0; break;
		default:						TRACE("ERROR: LSM6DS33 gyro full scale value at illegal setting"); return false; break;
	}
	TRACE("LSM6DS33 raw gyro resolution: %.2f milli-degrees/sec.", IMUsettings.gyro_mDPS);
	return true;
}

bool IMUinit(void)
{
	uint8_t ui8_reg[2] = {0};

	if (!I2C_LSM6DS33_ReadRegister(LSM6DS33_WHO_AM_I_ADDR, ui8_reg, 1))
	{
		TRACE("ERROR: LSM6DS33 did not respond to I2C address");
		return false;
	}
	if (ui8_reg[0] != LSM6DS33_WHOAMI)
	{
		TRACE("LSM6DS33 ERROR: Product ID read failes");
		return false;
	}
	TRACE("LSM6DS33 detected");

	// Set IMU configuration
	ui8_reg[0] = (LSM6DS33_ODR_104Hz << 4) | (LSM6DS33_LA_FS_4G << 2) | LSM6DS33_LA_AABW_100Hz; // Linear acceleration configuration
	ui8_reg[1] = (LSM6DS33_ODR_104Hz << 4) | (LSM6DS33_GY_FS_125dps < 1);						// Gyro configuration
	if (!I2C_LSM6DS33_WriteRegister(LSM6DS33_CTRL1_XL_ADDR, ui8_reg, 2))
	{
		TRACE("ERROR: Failed to write LSM6DS33 configuration");
		return false;
	}

	if (!IMUgetConf())
	{
		TRACE("ERROR: Failed ro read LSM6DS33 configuration");
		return false;
	}
	return true;
}

bool IMUread()
{
	uint8_t ui8_regs[14] = {0};

	int16_t i16_rawTemperature = 0;
	int16_t i16_rawGyroX = 0;
	int16_t i16_rawGyroY = 0;
	int16_t i16_rawGyroZ = 0;
	int16_t i16_rawAccX = 0;
	int16_t i16_rawAccY = 0;
	int16_t i16_rawAccZ = 0;

	// Check first if new data is available
	if (!I2C_LSM6DS33_ReadRegister(LSM6DS33_STATUS_REG_ADDR, ui8_regs, 1))
	{
		TRACE("ERROR: LSM6DS33 did not respond to I2C address");
		return false;
	}
	if ((ui8_regs[0] & 0x07) != 0x07)
	{
		TRACE("ERROR: LSM6DS33 has no new data available yet");
		return false;
	}

	if (!I2C_LSM6DS33_ReadRegister(LSM6DS33_OUT_TEMP_L_ADDR, ui8_regs, 14))
	{
		TRACE("ERROR: LSM6DS33 did not respond to I2C address");
		return false;
	}

	i16_rawTemperature = (ui8_regs[1] << 8) | ui8_regs[0];
	i16_rawGyroX = (ui8_regs[3] << 8) | ui8_regs[2];
	i16_rawGyroY = (ui8_regs[5] << 8) | ui8_regs[4];
	i16_rawGyroZ = (ui8_regs[7] << 8) | ui8_regs[6];
	i16_rawAccX = (ui8_regs[9] << 8) | ui8_regs[8];
	i16_rawAccY = (ui8_regs[11] << 8) | ui8_regs[10];
	i16_rawAccZ = (ui8_regs[13] << 8) | ui8_regs[12];

	IMUoutput.fGyroXradps = i16_rawGyroX * IMUsettings.gyro_mDPS * M_PI/180.0 / 1000.0;
	IMUoutput.fGyroYradps = i16_rawGyroY * IMUsettings.gyro_mDPS * M_PI/180.0 / 1000.0;
	IMUoutput.fGyroZradps = i16_rawGyroZ * IMUsettings.gyro_mDPS * M_PI/180.0 / 1000.0;

	IMUoutput.fAccX =  i16_rawAccX * IMUsettings.linacc_mG * GRAVITY_EARTH / 1000.0;
	IMUoutput.fAccY =  i16_rawAccY * IMUsettings.linacc_mG * GRAVITY_EARTH / 1000.0;
	IMUoutput.fAccZ =  i16_rawAccZ * IMUsettings.linacc_mG * GRAVITY_EARTH / 1000.0;

	IMUoutput.fTemperatureDegC = (float)i16_rawTemperature / 16.0 + 25.0;
	return true;
}

uint32_t ReadAnalogChannel(ADC_HandleTypeDef* hadc, uint32_t ui32Channel)
{
	ADC_ChannelConfTypeDef sConfig = {0};
	sConfig.Channel = ui32Channel;
	sConfig.Rank = 1;
	sConfig.SamplingTime = ADC_SAMPLETIME_3CYCLES;
	if (HAL_ADC_ConfigChannel(hadc, &sConfig) != HAL_OK)
	{
	    Error_Handler();
	}
	HAL_ADC_Start(hadc);
	HAL_ADC_PollForConversion(hadc, HAL_MAX_DELAY);
	return HAL_ADC_GetValue(hadc);
}
/* USER CODE END 0 */

int main(void)
{

  /* MCU Configuration--------------------------------------------------------*/

  /* Reset of all peripherals, Initializes the Flash interface and the Systick. */
  HAL_Init();

  /* Configure the system clock */
  SystemClock_Config();

  /* Initialize all configured peripherals */
  MX_GPIO_Init();
  MX_USB_OTG_FS_PCD_Init();
  MX_FMC_Init();
  MX_LTDC_Init();
  MX_I2C1_Init();
  MX_ADC3_Init();
  MX_DAC_Init();
  MX_SDIO_SD_Init();
  MX_SPI2_Init();
  MX_USART1_UART_Init();
  MX_USART2_UART_Init();
  MX_USART6_UART_Init();
  MX_FATFS_Init();
  MX_I2C2_Init();
  MX_ADC1_Init();
  /* USER CODE BEGIN 2 */
  HAL_GPIO_WritePin(PWRon_GPIO_Port, PWRon_Pin, GPIO_PIN_SET); // Turn on power
  HAL_GPIO_WritePin(LEDred_GPIO_Port, LEDred_Pin, GPIO_PIN_RESET);
  HAL_GPIO_WritePin(LEDgreen_GPIO_Port, LEDgreen_Pin, GPIO_PIN_SET);
  HAL_GPIO_WritePin(LEDblue_GPIO_Port, LEDblue_Pin, GPIO_PIN_RESET);

  // Turn on UART3 power
  HAL_GPIO_WritePin(UART3Pwr_GPIO_Port, UART3Pwr_Pin, GPIO_PIN_SET);

  // Turn on UART6 power
  HAL_GPIO_WritePin(UART6pwr_GPIO_Port, UART6pwr_Pin, GPIO_PIN_SET);

  HAL_Delay(100);

  if (!IMUinit())
  {
	  TRACE("ERROR: touchPanelInit() failed");
	  asm("bkpt 255");
  }

#ifdef WITHACCGYRO
#ifdef WITHMINMAX
  TRACE("STM32_T;T;AX;AY;AZ;GX;GY;GZ;LHm;LHc;LHM;LVm;LVc;LHM;RHm;RHc;RHM;RVm;RVc;RVM;S1m;S1c;S1M;VBatt");
#else
  TRACE("STM32_T;T;AX;AY;AZ;GX;GY;GZ;LH;LV;RH;RV;S1;VBatt");
#endif
#else
#ifdef WITHMINMAX
  TRACE("STM32_T;T;LHm;LHc;LHM;LVm;LVc;LHM;RHm;RHc;RHM;RVm;RVc;RVM;S1m;S1c;S1M;VBatt");
#else
  TRACE("STM32_T;T;LH;LV;RH;RV;S1;VBatt");
#endif
#endif
  HAL_Delay(1000);
#ifdef WITHMINMAX
  uint32_t ui32_StickLHmin = 4095;
  uint32_t ui32_StickLVmin = 4095;
  uint32_t ui32_StickRHmin = 4095;
  uint32_t ui32_StickRVmin = 4095;
  uint32_t ui32_Slider1min = 4095;
  uint32_t ui32_StickLHmax = 0;
  uint32_t ui32_StickLVmax = 0;
  uint32_t ui32_StickRHmax = 0;
  uint32_t ui32_StickRVmax = 0;
  uint32_t ui32_Slider1max = 0;

  uint8_t ui8_iterator = 0;
#endif
  /* USER CODE END 2 */

  /* Infinite loop */
  while (1)
  {

    /* USER CODE BEGIN 3 */
	  if (IMUread())
	  {
		  HAL_ADC_Start(&hadc1);
		  HAL_ADC_PollForConversion(&hadc1, HAL_MAX_DELAY);
		  uint32_t ui32_STM32Temperature = HAL_ADC_GetValue(&hadc1);
		  float fSTM32TempDegC = (80.0/(float)(*ADDR_TS_CAL2 - *ADDR_TS_CAL1))*(float)((float)ui32_STM32Temperature - *ADDR_TS_CAL1) + 30.0;

		  uint32_t ui32_StickLH = ReadAnalogChannel(&hadc3, ADC_CHANNEL_0);  // ADC3_IN0
		  uint32_t ui32_StickLV = ReadAnalogChannel(&hadc3, ADC_CHANNEL_1);  // ADC3_IN1
		  uint32_t ui32_StickRH = ReadAnalogChannel(&hadc3, ADC_CHANNEL_2);  // ADC3_IN2
		  uint32_t ui32_StickRV = ReadAnalogChannel(&hadc3, ADC_CHANNEL_3);  // ADC3_IN3
		  uint32_t ui32_Slider1 = ReadAnalogChannel(&hadc3, ADC_CHANNEL_4);  // ADC3_IN4
		  uint32_t ui32_VBatt   = ReadAnalogChannel(&hadc3, ADC_CHANNEL_5);  // ADC3_IN5

		  float f_VBatt = (float)(ui32_VBatt)*(3.3/4095.0) * ((120+39)/39);

		  //if (ui32_VBatt < 1950) // Low-voltage cut-off at 6.4V
		  if (f_VBatt < 6.4) // Low-voltage cut-off
		  {
			  HAL_GPIO_WritePin(PWRon_GPIO_Port, PWRon_Pin, GPIO_PIN_RESET); // Turn off power
			  HAL_Delay(1000);
		  }

#ifdef WITHMINMAX
		  if (ui32_StickLH < ui32_StickLHmin) ui32_StickLHmin = ui32_StickLH;
		  if (ui32_StickLH > ui32_StickLHmax) ui32_StickLHmax = ui32_StickLH;

		  if (ui32_StickLV < ui32_StickLVmin) ui32_StickLVmin = ui32_StickLV;
		  if (ui32_StickLV > ui32_StickLVmax) ui32_StickLVmax = ui32_StickLV;

		  if (ui32_StickRH < ui32_StickRHmin) ui32_StickRHmin = ui32_StickRH;
		  if (ui32_StickRH > ui32_StickRHmax) ui32_StickRHmax = ui32_StickRH;

		  if (ui32_StickRV < ui32_StickRVmin) ui32_StickRVmin = ui32_StickRV;
		  if (ui32_StickRV > ui32_StickRVmax) ui32_StickRVmax = ui32_StickRV;

		  if (ui32_Slider1 < ui32_Slider1min) ui32_Slider1min = ui32_Slider1;
		  if (ui32_Slider1 > ui32_Slider1max) ui32_Slider1max = ui32_Slider1;

		  ui8_iterator++;
		  HAL_Delay(50);

		  if (ui8_iterator > 20)
		  {
			  ui8_iterator = 0;
#endif

#ifdef WITHACCGYRO
#ifdef WITHMINMAX
			  TRACE("%.2f;%.2f;%.2f;%.2f;%.2f;%.2f;%.2f;%.2f;%lu;%lu;%lu;%lu;%lu;%lu;%lu;%lu;%lu;%lu;%lu;%lu;%lu;%lu;%lu;%.1f",
		  		  		  fSTM32TempDegC, IMUoutput.fTemperatureDegC, IMUoutput.fAccX, IMUoutput.fAccY, IMUoutput.fAccZ, IMUoutput.fGyroXradps, IMUoutput.fGyroYradps, IMUoutput.fGyroZradps,
						  ui32_StickLHmin, ui32_StickLH, ui32_StickLHmax,
						  ui32_StickLVmin, ui32_StickLV, ui32_StickLVmax,
						  ui32_StickRHmin, ui32_StickRH, ui32_StickRHmax,
						  ui32_StickRVmin, ui32_StickRV, ui32_StickRVmax,
						  ui32_Slider1min, ui32_Slider1, ui32_Slider1max, f_VBatt);
#else
			  TRACE("%.2f;%.2f;%.2f;%.2f;%.2f;%.2f;%.2f;%.2f;%lu;%lu;%lu;%lu;%lu;%.1f",
		  		  		  fSTM32TempDegC, IMUoutput.fTemperatureDegC, IMUoutput.fAccX, IMUoutput.fAccY, IMUoutput.fAccZ, IMUoutput.fGyroXradps, IMUoutput.fGyroYradps, IMUoutput.fGyroZradps,
						  ui32_StickLH, ui32_StickLV, ui32_StickRH, ui32_StickRV, ui32_Slider1, f_VBatt);
#endif
#else
#ifdef WITHMINMAX
			  TRACE("%.2f;%.2f;%lu;%lu;%lu;%lu;%lu;%lu;%lu;%lu;%lu;%lu;%lu;%lu;%lu;%lu;%lu;%.1f",
		  		  		  fSTM32TempDegC, IMUoutput.fTemperatureDegC,
						  ui32_StickLHmin, ui32_StickLH, ui32_StickLHmax,
						  ui32_StickLVmin, ui32_StickLV, ui32_StickLVmax,
						  ui32_StickRHmin, ui32_StickRH, ui32_StickRHmax,
						  ui32_StickRVmin, ui32_StickRV, ui32_StickRVmax,
						  ui32_Slider1min, ui32_Slider1, ui32_Slider1max, f_VBatt);
#else
			  TRACE("%.2f;%.2f;%lu;%lu;%lu;%lu;%lu;%.1f",
		  		  		  fSTM32TempDegC, IMUoutput.fTemperatureDegC,
						  ui32_StickLH, ui32_StickLV, ui32_StickRH, ui32_StickRV, ui32_Slider1, f_VBatt);
#endif
#endif
#ifdef WITHMINMAX
		  }
#else
		  HAL_Delay(10000); // Measurement every 10 sec.
#endif
	  }
	  else
		  TRACE("Failed reading IMU");

	  // Check Power-Off
	  if (HAL_GPIO_ReadPin(PWRswitch_GPIO_Port, PWRswitch_Pin) == GPIO_PIN_RESET)
	  {
		  //HAL_GPIO_WritePin(LEDred_GPIO_Port, LEDred_Pin, GPIO_PIN_SET);
		  //HAL_GPIO_WritePin(LEDgreen_GPIO_Port, LEDgreen_Pin, GPIO_PIN_RESET);
		  HAL_GPIO_WritePin(LEDblue_GPIO_Port, LEDblue_Pin, GPIO_PIN_SET);

		  // Check again in 1 second
		  HAL_Delay(1000);
		  if (HAL_GPIO_ReadPin(PWRswitch_GPIO_Port, PWRswitch_Pin) == GPIO_PIN_RESET)
		  {
			  HAL_GPIO_WritePin(PWRon_GPIO_Port, PWRon_Pin, GPIO_PIN_RESET); // Turn off power
		  }
	  }
	  HAL_GPIO_WritePin(LEDblue_GPIO_Port, LEDblue_Pin, GPIO_PIN_RESET);
  }
  /* USER CODE END 3 */
}

void SystemClock_Config(void)
{
  RCC_OscInitTypeDef RCC_OscInitStruct = {0};
  RCC_ClkInitTypeDef RCC_ClkInitStruct = {0};
  RCC_PeriphCLKInitTypeDef PeriphClkInitStruct = {0};

  /** Configure the main internal regulator output voltage
  */
  __HAL_RCC_PWR_CLK_ENABLE();
  __HAL_PWR_VOLTAGESCALING_CONFIG(PWR_REGULATOR_VOLTAGE_SCALE1);
  /** Initializes the RCC Oscillators according to the specified parameters
  * in the RCC_OscInitTypeDef structure.
  */
  RCC_OscInitStruct.OscillatorType = RCC_OSCILLATORTYPE_HSE;
  RCC_OscInitStruct.HSEState = RCC_HSE_ON;
  RCC_OscInitStruct.PLL.PLLState = RCC_PLL_ON;
  RCC_OscInitStruct.PLL.PLLSource = RCC_PLLSOURCE_HSE;
  RCC_OscInitStruct.PLL.PLLM = 6;
  RCC_OscInitStruct.PLL.PLLN = 168;
  RCC_OscInitStruct.PLL.PLLP = RCC_PLLP_DIV2;
  RCC_OscInitStruct.PLL.PLLQ = 7;
  if (HAL_RCC_OscConfig(&RCC_OscInitStruct) != HAL_OK)
  {
    Error_Handler();
  }
  /** Initializes the CPU, AHB and APB buses clocks
  */
  RCC_ClkInitStruct.ClockType = RCC_CLOCKTYPE_HCLK|RCC_CLOCKTYPE_SYSCLK
                              |RCC_CLOCKTYPE_PCLK1|RCC_CLOCKTYPE_PCLK2;
  RCC_ClkInitStruct.SYSCLKSource = RCC_SYSCLKSOURCE_PLLCLK;
  RCC_ClkInitStruct.AHBCLKDivider = RCC_SYSCLK_DIV1;
  RCC_ClkInitStruct.APB1CLKDivider = RCC_HCLK_DIV4;
  RCC_ClkInitStruct.APB2CLKDivider = RCC_HCLK_DIV2;

  if (HAL_RCC_ClockConfig(&RCC_ClkInitStruct, FLASH_LATENCY_5) != HAL_OK)
  {
    Error_Handler();
  }
  PeriphClkInitStruct.PeriphClockSelection = RCC_PERIPHCLK_LTDC;
  PeriphClkInitStruct.PLLSAI.PLLSAIN = 50;
  PeriphClkInitStruct.PLLSAI.PLLSAIR = 2;
  PeriphClkInitStruct.PLLSAIDivR = RCC_PLLSAIDIVR_2;
  if (HAL_RCCEx_PeriphCLKConfig(&PeriphClkInitStruct) != HAL_OK)
  {
    Error_Handler();
  }
}

static void MX_ADC1_Init(void)
{

  ADC_ChannelConfTypeDef sConfig = {0};

  /** Configure the global features of the ADC (Clock, Resolution, Data Alignment and number of conversion)
  */
  hadc1.Instance = ADC1;
  hadc1.Init.ClockPrescaler = ADC_CLOCK_SYNC_PCLK_DIV4;
  hadc1.Init.Resolution = ADC_RESOLUTION_12B;
  hadc1.Init.ScanConvMode = DISABLE;
  hadc1.Init.ContinuousConvMode = DISABLE;
  hadc1.Init.DiscontinuousConvMode = DISABLE;
  hadc1.Init.ExternalTrigConvEdge = ADC_EXTERNALTRIGCONVEDGE_NONE;
  hadc1.Init.ExternalTrigConv = ADC_SOFTWARE_START;
  hadc1.Init.DataAlign = ADC_DATAALIGN_RIGHT;
  hadc1.Init.NbrOfConversion = 1;
  hadc1.Init.DMAContinuousRequests = DISABLE;
  hadc1.Init.EOCSelection = ADC_EOC_SINGLE_CONV;
  if (HAL_ADC_Init(&hadc1) != HAL_OK)
  {
    Error_Handler();
  }
  /** Configure for the selected ADC regular channel its corresponding rank in the sequencer and its sample time.
  */
  sConfig.Channel = ADC_CHANNEL_TEMPSENSOR;
  sConfig.Rank = 1;
  sConfig.SamplingTime = ADC_SAMPLETIME_3CYCLES;
  if (HAL_ADC_ConfigChannel(&hadc1, &sConfig) != HAL_OK)
  {
    Error_Handler();
  }

}

static void MX_ADC3_Init(void)
{

  ADC_ChannelConfTypeDef sConfig = {0};

  /** Configure the global features of the ADC (Clock, Resolution, Data Alignment and number of conversion)
  */
  hadc3.Instance = ADC3;
  hadc3.Init.ClockPrescaler = ADC_CLOCK_SYNC_PCLK_DIV4;
  hadc3.Init.Resolution = ADC_RESOLUTION_12B;
  hadc3.Init.ScanConvMode = DISABLE;
  hadc3.Init.ContinuousConvMode = DISABLE;
  hadc3.Init.DiscontinuousConvMode = DISABLE;
  hadc3.Init.ExternalTrigConvEdge = ADC_EXTERNALTRIGCONVEDGE_NONE;
  hadc3.Init.ExternalTrigConv = ADC_SOFTWARE_START;
  hadc3.Init.DataAlign = ADC_DATAALIGN_RIGHT;
  hadc3.Init.NbrOfConversion = 1;
  hadc3.Init.DMAContinuousRequests = DISABLE;
  hadc3.Init.EOCSelection = ADC_EOC_SINGLE_CONV;
  if (HAL_ADC_Init(&hadc3) != HAL_OK)
  {
    Error_Handler();
  }
  /** Configure for the selected ADC regular channel its corresponding rank in the sequencer and its sample time.
  */
  sConfig.Channel = ADC_CHANNEL_0;
  sConfig.Rank = 1;
  sConfig.SamplingTime = ADC_SAMPLETIME_3CYCLES;
  if (HAL_ADC_ConfigChannel(&hadc3, &sConfig) != HAL_OK)
  {
    Error_Handler();
  }

}

static void MX_DAC_Init(void)
{

  DAC_ChannelConfTypeDef sConfig = {0};

  /** DAC Initialization
  */
  hdac.Instance = DAC;
  if (HAL_DAC_Init(&hdac) != HAL_OK)
  {
    Error_Handler();
  }
  /** DAC channel OUT1 config
  */
  sConfig.DAC_Trigger = DAC_TRIGGER_NONE;
  sConfig.DAC_OutputBuffer = DAC_OUTPUTBUFFER_ENABLE;
  if (HAL_DAC_ConfigChannel(&hdac, &sConfig, DAC_CHANNEL_1) != HAL_OK)
  {
    Error_Handler();
  }

}

static void MX_I2C1_Init(void)
{

  hi2c1.Instance = I2C1;
  hi2c1.Init.ClockSpeed = 400000;
  hi2c1.Init.DutyCycle = I2C_DUTYCYCLE_16_9;
  hi2c1.Init.OwnAddress1 = 0;
  hi2c1.Init.AddressingMode = I2C_ADDRESSINGMODE_7BIT;
  hi2c1.Init.DualAddressMode = I2C_DUALADDRESS_DISABLE;
  hi2c1.Init.OwnAddress2 = 0;
  hi2c1.Init.GeneralCallMode = I2C_GENERALCALL_DISABLE;
  hi2c1.Init.NoStretchMode = I2C_NOSTRETCH_DISABLE;
  if (HAL_I2C_Init(&hi2c1) != HAL_OK)
  {
    Error_Handler();
  }
  /** Configure Analogue filter
  */
  if (HAL_I2CEx_ConfigAnalogFilter(&hi2c1, I2C_ANALOGFILTER_ENABLE) != HAL_OK)
  {
    Error_Handler();
  }
  /** Configure Digital filter
  */
  if (HAL_I2CEx_ConfigDigitalFilter(&hi2c1, 0) != HAL_OK)
  {
    Error_Handler();
  }

}

static void MX_I2C2_Init(void)
{

  hi2c2.Instance = I2C2;
  hi2c2.Init.ClockSpeed = 400000;
  hi2c2.Init.DutyCycle = I2C_DUTYCYCLE_2;
  hi2c2.Init.OwnAddress1 = 0;
  hi2c2.Init.AddressingMode = I2C_ADDRESSINGMODE_7BIT;
  hi2c2.Init.DualAddressMode = I2C_DUALADDRESS_DISABLE;
  hi2c2.Init.OwnAddress2 = 0;
  hi2c2.Init.GeneralCallMode = I2C_GENERALCALL_DISABLE;
  hi2c2.Init.NoStretchMode = I2C_NOSTRETCH_DISABLE;
  if (HAL_I2C_Init(&hi2c2) != HAL_OK)
  {
    Error_Handler();
  }
  /** Configure Analogue filter
  */
  if (HAL_I2CEx_ConfigAnalogFilter(&hi2c2, I2C_ANALOGFILTER_ENABLE) != HAL_OK)
  {
    Error_Handler();
  }
  /** Configure Digital filter
  */
  if (HAL_I2CEx_ConfigDigitalFilter(&hi2c2, 0) != HAL_OK)
  {
    Error_Handler();
  }

}

static void MX_LTDC_Init(void)
{

  LTDC_LayerCfgTypeDef pLayerCfg = {0};
  LTDC_LayerCfgTypeDef pLayerCfg1 = {0};

  hltdc.Instance = LTDC;
  hltdc.Init.HSPolarity = LTDC_HSPOLARITY_AL;
  hltdc.Init.VSPolarity = LTDC_VSPOLARITY_AL;
  hltdc.Init.DEPolarity = LTDC_DEPOLARITY_AL;
  hltdc.Init.PCPolarity = LTDC_PCPOLARITY_IPC;
  hltdc.Init.HorizontalSync = 2;
  hltdc.Init.VerticalSync = 10;
  hltdc.Init.AccumulatedHBP = 42;
  hltdc.Init.AccumulatedVBP = 12;
  hltdc.Init.AccumulatedActiveW = 522;
  hltdc.Init.AccumulatedActiveH = 284;
  hltdc.Init.TotalWidth = 525;
  hltdc.Init.TotalHeigh = 286;
  hltdc.Init.Backcolor.Blue = 0;
  hltdc.Init.Backcolor.Green = 0;
  hltdc.Init.Backcolor.Red = 0;
  if (HAL_LTDC_Init(&hltdc) != HAL_OK)
  {
    Error_Handler();
  }
  pLayerCfg.WindowX0 = 0;
  pLayerCfg.WindowX1 = 479;
  pLayerCfg.WindowY0 = 0;
  pLayerCfg.WindowY1 = 271;
  pLayerCfg.PixelFormat = LTDC_PIXEL_FORMAT_RGB565;
  pLayerCfg.Alpha = 255;
  pLayerCfg.Alpha0 = 0;
  pLayerCfg.BlendingFactor1 = LTDC_BLENDING_FACTOR1_CA;
  pLayerCfg.BlendingFactor2 = LTDC_BLENDING_FACTOR2_CA;
  pLayerCfg.FBStartAdress = 261120;
  pLayerCfg.ImageWidth = 480;
  pLayerCfg.ImageHeight = 272;
  pLayerCfg.Backcolor.Blue = 0;
  pLayerCfg.Backcolor.Green = 0;
  pLayerCfg.Backcolor.Red = 0;
  if (HAL_LTDC_ConfigLayer(&hltdc, &pLayerCfg, 0) != HAL_OK)
  {
    Error_Handler();
  }
  pLayerCfg1.WindowX0 = 0;
  pLayerCfg1.WindowX1 = 479;
  pLayerCfg1.WindowY0 = 0;
  pLayerCfg1.WindowY1 = 271;
  pLayerCfg1.PixelFormat = LTDC_PIXEL_FORMAT_RGB565;
  pLayerCfg1.Alpha = 255;
  pLayerCfg1.Alpha0 = 0;
  pLayerCfg1.BlendingFactor1 = LTDC_BLENDING_FACTOR1_CA;
  pLayerCfg1.BlendingFactor2 = LTDC_BLENDING_FACTOR2_CA;
  pLayerCfg1.FBStartAdress = 261120;
  pLayerCfg1.ImageWidth = 480;
  pLayerCfg1.ImageHeight = 272;
  pLayerCfg1.Backcolor.Blue = 0;
  pLayerCfg1.Backcolor.Green = 0;
  pLayerCfg1.Backcolor.Red = 0;
  if (HAL_LTDC_ConfigLayer(&hltdc, &pLayerCfg1, 1) != HAL_OK)
  {
    Error_Handler();
  }

}

static void MX_SDIO_SD_Init(void)
{

  hsd.Instance = SDIO;
  hsd.Init.ClockEdge = SDIO_CLOCK_EDGE_RISING;
  hsd.Init.ClockBypass = SDIO_CLOCK_BYPASS_DISABLE;
  hsd.Init.ClockPowerSave = SDIO_CLOCK_POWER_SAVE_DISABLE;
  hsd.Init.BusWide = SDIO_BUS_WIDE_1B;
  hsd.Init.HardwareFlowControl = SDIO_HARDWARE_FLOW_CONTROL_DISABLE;
  hsd.Init.ClockDiv = 0;

}

static void MX_SPI2_Init(void)
{

  /* SPI2 parameter configuration*/
  hspi2.Instance = SPI2;
  hspi2.Init.Mode = SPI_MODE_MASTER;
  hspi2.Init.Direction = SPI_DIRECTION_2LINES;
  hspi2.Init.DataSize = SPI_DATASIZE_8BIT;
  hspi2.Init.CLKPolarity = SPI_POLARITY_LOW;
  hspi2.Init.CLKPhase = SPI_PHASE_1EDGE;
  hspi2.Init.NSS = SPI_NSS_HARD_OUTPUT;
  hspi2.Init.BaudRatePrescaler = SPI_BAUDRATEPRESCALER_2;
  hspi2.Init.FirstBit = SPI_FIRSTBIT_MSB;
  hspi2.Init.TIMode = SPI_TIMODE_DISABLE;
  hspi2.Init.CRCCalculation = SPI_CRCCALCULATION_DISABLE;
  hspi2.Init.CRCPolynomial = 10;
  if (HAL_SPI_Init(&hspi2) != HAL_OK)
  {
    Error_Handler();
  }

}

static void MX_USART1_UART_Init(void)
{

  huart1.Instance = USART1;
  huart1.Init.BaudRate = 115200;
  huart1.Init.WordLength = UART_WORDLENGTH_8B;
  huart1.Init.StopBits = UART_STOPBITS_1;
  huart1.Init.Parity = UART_PARITY_NONE;
  huart1.Init.Mode = UART_MODE_TX_RX;
  huart1.Init.HwFlowCtl = UART_HWCONTROL_NONE;
  huart1.Init.OverSampling = UART_OVERSAMPLING_16;
  if (HAL_UART_Init(&huart1) != HAL_OK)
  {
    Error_Handler();
  }

}

static void MX_USART2_UART_Init(void)
{

  huart2.Instance = USART2;
  huart2.Init.BaudRate = 115200;
  huart2.Init.WordLength = UART_WORDLENGTH_8B;
  huart2.Init.StopBits = UART_STOPBITS_1;
  huart2.Init.Parity = UART_PARITY_NONE;
  huart2.Init.Mode = UART_MODE_TX_RX;
  huart2.Init.HwFlowCtl = UART_HWCONTROL_NONE;
  huart2.Init.OverSampling = UART_OVERSAMPLING_16;
  if (HAL_UART_Init(&huart2) != HAL_OK)
  {
    Error_Handler();
  }

}

static void MX_USART6_UART_Init(void)
{

  huart6.Instance = USART6;
  huart6.Init.BaudRate = 115200;
  huart6.Init.WordLength = UART_WORDLENGTH_8B;
  huart6.Init.StopBits = UART_STOPBITS_1;
  huart6.Init.Parity = UART_PARITY_NONE;
  huart6.Init.Mode = UART_MODE_TX_RX;
  huart6.Init.HwFlowCtl = UART_HWCONTROL_NONE;
  huart6.Init.OverSampling = UART_OVERSAMPLING_16;
  if (HAL_UART_Init(&huart6) != HAL_OK)
  {
    Error_Handler();
  }

}

static void MX_USB_OTG_FS_PCD_Init(void)
{

  hpcd_USB_OTG_FS.Instance = USB_OTG_FS;
  hpcd_USB_OTG_FS.Init.dev_endpoints = 4;
  hpcd_USB_OTG_FS.Init.speed = PCD_SPEED_FULL;
  hpcd_USB_OTG_FS.Init.dma_enable = DISABLE;
  hpcd_USB_OTG_FS.Init.phy_itface = PCD_PHY_EMBEDDED;
  hpcd_USB_OTG_FS.Init.Sof_enable = DISABLE;
  hpcd_USB_OTG_FS.Init.low_power_enable = DISABLE;
  hpcd_USB_OTG_FS.Init.lpm_enable = DISABLE;
  hpcd_USB_OTG_FS.Init.vbus_sensing_enable = ENABLE;
  hpcd_USB_OTG_FS.Init.use_dedicated_ep1 = DISABLE;
  if (HAL_PCD_Init(&hpcd_USB_OTG_FS) != HAL_OK)
  {
    Error_Handler();
  }

}

/* FMC initialization function */
static void MX_FMC_Init(void)
{

  FMC_SDRAM_TimingTypeDef SdramTiming = {0};

  /** Perform the SDRAM1 memory initialization sequence
  */
  hsdram1.Instance = FMC_SDRAM_DEVICE;
  /* hsdram1.Init */
  hsdram1.Init.SDBank = FMC_SDRAM_BANK2;
  hsdram1.Init.ColumnBitsNumber = FMC_SDRAM_COLUMN_BITS_NUM_8;
  hsdram1.Init.RowBitsNumber = FMC_SDRAM_ROW_BITS_NUM_12;
  hsdram1.Init.MemoryDataWidth = FMC_SDRAM_MEM_BUS_WIDTH_16;
  hsdram1.Init.InternalBankNumber = FMC_SDRAM_INTERN_BANKS_NUM_4;
  hsdram1.Init.CASLatency = FMC_SDRAM_CAS_LATENCY_1;
  hsdram1.Init.WriteProtection = FMC_SDRAM_WRITE_PROTECTION_DISABLE;
  hsdram1.Init.SDClockPeriod = FMC_SDRAM_CLOCK_DISABLE;
  hsdram1.Init.ReadBurst = FMC_SDRAM_RBURST_DISABLE;
  hsdram1.Init.ReadPipeDelay = FMC_SDRAM_RPIPE_DELAY_0;
  /* SdramTiming */
  SdramTiming.LoadToActiveDelay = 16;
  SdramTiming.ExitSelfRefreshDelay = 16;
  SdramTiming.SelfRefreshTime = 16;
  SdramTiming.RowCycleDelay = 16;
  SdramTiming.WriteRecoveryTime = 16;
  SdramTiming.RPDelay = 16;
  SdramTiming.RCDDelay = 16;

  if (HAL_SDRAM_Init(&hsdram1, &SdramTiming) != HAL_OK)
  {
    Error_Handler( );
  }

}

static void MX_GPIO_Init(void)
{
  GPIO_InitTypeDef GPIO_InitStruct = {0};

  /* GPIO Ports Clock Enable */
  __HAL_RCC_GPIOE_CLK_ENABLE();
  __HAL_RCC_GPIOI_CLK_ENABLE();
  __HAL_RCC_GPIOC_CLK_ENABLE();
  __HAL_RCC_GPIOF_CLK_ENABLE();
  __HAL_RCC_GPIOH_CLK_ENABLE();
  __HAL_RCC_GPIOA_CLK_ENABLE();
  __HAL_RCC_GPIOB_CLK_ENABLE();
  __HAL_RCC_GPIOJ_CLK_ENABLE();
  __HAL_RCC_GPIOG_CLK_ENABLE();
  __HAL_RCC_GPIOD_CLK_ENABLE();
  __HAL_RCC_GPIOK_CLK_ENABLE();

  /*Configure GPIO pin Output Level */
  HAL_GPIO_WritePin(GPIOE, LEDred_Pin|LEDgreen_Pin|LEDblue_Pin|HAPTIC_Pin, GPIO_PIN_RESET);

  /*Configure GPIO pin Output Level */
  HAL_GPIO_WritePin(INTMODboot_GPIO_Port, INTMODboot_Pin, GPIO_PIN_RESET);

  /*Configure GPIO pin Output Level */
  HAL_GPIO_WritePin(LCDnRST_GPIO_Port, LCDnRST_Pin, GPIO_PIN_SET);

  /*Configure GPIO pin Output Level */
  HAL_GPIO_WritePin(TOUCH_RST_GPIO_Port, TOUCH_RST_Pin, GPIO_PIN_RESET);

  /*Configure GPIO pin Output Level */
  HAL_GPIO_WritePin(GPIOA, TESTPOINT_Pin|IntModPwr_Pin|UART3Pwr_Pin, GPIO_PIN_RESET);

  /*Configure GPIO pin Output Level */
  HAL_GPIO_WritePin(AudioMute_GPIO_Port, AudioMute_Pin, GPIO_PIN_SET);

  /*Configure GPIO pin Output Level */
  HAL_GPIO_WritePin(GPIOB, UART6pwr_Pin|LCDbacklight_Pin|ExtModPwr_Pin, GPIO_PIN_RESET);

  /*Configure GPIO pin Output Level */
  HAL_GPIO_WritePin(PWRon_GPIO_Port, PWRon_Pin, GPIO_PIN_SET);

  /*Configure GPIO pin Output Level */
  HAL_GPIO_WritePin(TrainerOut_GPIO_Port, TrainerOut_Pin, GPIO_PIN_RESET);

  /*Configure GPIO pin Output Level */
  HAL_GPIO_WritePin(TelemDir_GPIO_Port, TelemDir_Pin, GPIO_PIN_RESET);

  /*Configure GPIO pin Output Level */
  HAL_GPIO_WritePin(BluetoothEn_GPIO_Port, BluetoothEn_Pin, GPIO_PIN_RESET);

  /*Configure GPIO pins : LEDred_Pin LEDgreen_Pin LEDblue_Pin HAPTIC_Pin */
  GPIO_InitStruct.Pin = LEDred_Pin|LEDgreen_Pin|LEDblue_Pin|HAPTIC_Pin;
  GPIO_InitStruct.Mode = GPIO_MODE_OUTPUT_PP;
  GPIO_InitStruct.Pull = GPIO_NOPULL;
  GPIO_InitStruct.Speed = GPIO_SPEED_FREQ_LOW;
  HAL_GPIO_Init(GPIOE, &GPIO_InitStruct);

  /*Configure GPIO pin : SWEL_Pin */
  GPIO_InitStruct.Pin = SWEL_Pin;
  GPIO_InitStruct.Mode = GPIO_MODE_INPUT;
  GPIO_InitStruct.Pull = GPIO_NOPULL;
  HAL_GPIO_Init(SWEL_GPIO_Port, &GPIO_InitStruct);

  /*Configure GPIO pins : KEYenter_Pin KEYpageprevious_Pin SWAL_Pin KEYrtn_Pin
                           KEYtelem_Pin KEYmdl_Pin KEYsys_Pin */
  GPIO_InitStruct.Pin = KEYenter_Pin|KEYpageprevious_Pin|SWAL_Pin|KEYrtn_Pin
                          |KEYtelem_Pin|KEYmdl_Pin|KEYsys_Pin;
  GPIO_InitStruct.Mode = GPIO_MODE_INPUT;
  GPIO_InitStruct.Pull = GPIO_PULLUP;
  HAL_GPIO_Init(GPIOI, &GPIO_InitStruct);

  /*Configure GPIO pins : KEYpagenext_Pin TrimLHR_Pin */
  GPIO_InitStruct.Pin = KEYpagenext_Pin|TrimLHR_Pin;
  GPIO_InitStruct.Mode = GPIO_MODE_INPUT;
  GPIO_InitStruct.Pull = GPIO_PULLUP;
  HAL_GPIO_Init(GPIOC, &GPIO_InitStruct);

  /*Configure GPIO pins : INTMODboot_Pin LCDnRST_Pin */
  GPIO_InitStruct.Pin = INTMODboot_Pin|LCDnRST_Pin;
  GPIO_InitStruct.Mode = GPIO_MODE_OUTPUT_PP;
  GPIO_InitStruct.Pull = GPIO_NOPULL;
  GPIO_InitStruct.Speed = GPIO_SPEED_FREQ_LOW;
  HAL_GPIO_Init(GPIOI, &GPIO_InitStruct);

  /*Configure GPIO pin : TOUCH_RST_Pin */
  GPIO_InitStruct.Pin = TOUCH_RST_Pin;
  GPIO_InitStruct.Mode = GPIO_MODE_OUTPUT_PP;
  GPIO_InitStruct.Pull = GPIO_NOPULL;
  GPIO_InitStruct.Speed = GPIO_SPEED_FREQ_LOW;
  HAL_GPIO_Init(TOUCH_RST_GPIO_Port, &GPIO_InitStruct);

  /*Configure GPIO pins : TOUCH_INT_Pin PCBREV1_Pin PCBREV2_Pin ROTENCB_Pin
                           ROTENCA_Pin */
  GPIO_InitStruct.Pin = TOUCH_INT_Pin|PCBREV1_Pin|PCBREV2_Pin|ROTENCB_Pin
                          |ROTENCA_Pin;
  GPIO_InitStruct.Mode = GPIO_MODE_INPUT;
  GPIO_InitStruct.Pull = GPIO_NOPULL;
  HAL_GPIO_Init(GPIOH, &GPIO_InitStruct);

  /*Configure GPIO pins : SWF_Pin SWEH_Pin SWAH_Pin SWBH_Pin
                           SWI_Pin SWJ_Pin */
  GPIO_InitStruct.Pin = SWF_Pin|SWEH_Pin|SWAH_Pin|SWBH_Pin
                          |SWI_Pin|SWJ_Pin;
  GPIO_InitStruct.Mode = GPIO_MODE_INPUT;
  GPIO_InitStruct.Pull = GPIO_PULLUP;
  HAL_GPIO_Init(GPIOH, &GPIO_InitStruct);

  /*Configure GPIO pins : TESTPOINT_Pin AudioMute_Pin IntModPwr_Pin UART3Pwr_Pin */
  GPIO_InitStruct.Pin = TESTPOINT_Pin|AudioMute_Pin|IntModPwr_Pin|UART3Pwr_Pin;
  GPIO_InitStruct.Mode = GPIO_MODE_OUTPUT_PP;
  GPIO_InitStruct.Pull = GPIO_NOPULL;
  GPIO_InitStruct.Speed = GPIO_SPEED_FREQ_LOW;
  HAL_GPIO_Init(GPIOA, &GPIO_InitStruct);

  /*Configure GPIO pin : TrimLHL_Pin */
  GPIO_InitStruct.Pin = TrimLHL_Pin;
  GPIO_InitStruct.Mode = GPIO_MODE_INPUT;
  GPIO_InitStruct.Pull = GPIO_PULLUP;
  HAL_GPIO_Init(TrimLHL_GPIO_Port, &GPIO_InitStruct);

  /*Configure GPIO pins : SDpresent_Pin TrainerIn_Pin */
  GPIO_InitStruct.Pin = SDpresent_Pin|TrainerIn_Pin;
  GPIO_InitStruct.Mode = GPIO_MODE_INPUT;
  GPIO_InitStruct.Pull = GPIO_NOPULL;
  HAL_GPIO_Init(GPIOC, &GPIO_InitStruct);

  /*Configure GPIO pins : UART6pwr_Pin LCDbacklight_Pin ExtModPwr_Pin */
  GPIO_InitStruct.Pin = UART6pwr_Pin|LCDbacklight_Pin|ExtModPwr_Pin;
  GPIO_InitStruct.Mode = GPIO_MODE_OUTPUT_PP;
  GPIO_InitStruct.Pull = GPIO_NOPULL;
  GPIO_InitStruct.Speed = GPIO_SPEED_FREQ_LOW;
  HAL_GPIO_Init(GPIOB, &GPIO_InitStruct);

  /*Configure GPIO pin : PWRswitch_Pin */
  GPIO_InitStruct.Pin = PWRswitch_Pin;
  GPIO_InitStruct.Mode = GPIO_MODE_INPUT;
  GPIO_InitStruct.Pull = GPIO_NOPULL;
  HAL_GPIO_Init(PWRswitch_GPIO_Port, &GPIO_InitStruct);

  /*Configure GPIO pin : PWRon_Pin */
  GPIO_InitStruct.Pin = PWRon_Pin;
  GPIO_InitStruct.Mode = GPIO_MODE_OUTPUT_PP;
  GPIO_InitStruct.Pull = GPIO_NOPULL;
  GPIO_InitStruct.Speed = GPIO_SPEED_FREQ_LOW;
  HAL_GPIO_Init(PWRon_GPIO_Port, &GPIO_InitStruct);

  /*Configure GPIO pins : SWBL_Pin TrainerDetect_Pin */
  GPIO_InitStruct.Pin = SWBL_Pin|TrainerDetect_Pin;
  GPIO_InitStruct.Mode = GPIO_MODE_INPUT;
  GPIO_InitStruct.Pull = GPIO_NOPULL;
  HAL_GPIO_Init(GPIOB, &GPIO_InitStruct);

  /*Configure GPIO pins : TrimRSD_Pin TrimRSU_Pin SWCL_Pin */
  GPIO_InitStruct.Pin = TrimRSD_Pin|TrimRSU_Pin|SWCL_Pin;
  GPIO_InitStruct.Mode = GPIO_MODE_INPUT;
  GPIO_InitStruct.Pull = GPIO_PULLUP;
  HAL_GPIO_Init(GPIOB, &GPIO_InitStruct);

  /*Configure GPIO pins : SWCH_Pin TrimLSU_Pin TrimR_Pin TrimRHR_Pin */
  GPIO_InitStruct.Pin = SWCH_Pin|TrimLSU_Pin|TrimR_Pin|TrimRHR_Pin;
  GPIO_InitStruct.Mode = GPIO_MODE_INPUT;
  GPIO_InitStruct.Pull = GPIO_PULLUP;
  HAL_GPIO_Init(GPIOD, &GPIO_InitStruct);

  /*Configure GPIO pin : HEARTBEAT_Pin */
  GPIO_InitStruct.Pin = HEARTBEAT_Pin;
  GPIO_InitStruct.Mode = GPIO_MODE_INPUT;
  GPIO_InitStruct.Pull = GPIO_NOPULL;
  HAL_GPIO_Init(HEARTBEAT_GPIO_Port, &GPIO_InitStruct);

  /*Configure GPIO pins : SWDH_Pin TrimLSD_Pin TrimRV_Pin TrimRVD_Pin
                           TrimLVU_Pin */
  GPIO_InitStruct.Pin = SWDH_Pin|TrimLSD_Pin|TrimRV_Pin|TrimRVD_Pin
                          |TrimLVU_Pin;
  GPIO_InitStruct.Mode = GPIO_MODE_INPUT;
  GPIO_InitStruct.Pull = GPIO_PULLUP;
  HAL_GPIO_Init(GPIOJ, &GPIO_InitStruct);

  /*Configure GPIO pins : SWDL_Pin SWGL_Pin SWGH_Pin SWH_Pin
                           TrimLVD_Pin */
  GPIO_InitStruct.Pin = SWDL_Pin|SWGL_Pin|SWGH_Pin|SWH_Pin
                          |TrimLVD_Pin;
  GPIO_InitStruct.Mode = GPIO_MODE_INPUT;
  GPIO_InitStruct.Pull = GPIO_PULLUP;
  HAL_GPIO_Init(GPIOG, &GPIO_InitStruct);

  /*Configure GPIO pin : TrainerOut_Pin */
  GPIO_InitStruct.Pin = TrainerOut_Pin;
  GPIO_InitStruct.Mode = GPIO_MODE_OUTPUT_PP;
  GPIO_InitStruct.Pull = GPIO_NOPULL;
  GPIO_InitStruct.Speed = GPIO_SPEED_FREQ_LOW;
  HAL_GPIO_Init(TrainerOut_GPIO_Port, &GPIO_InitStruct);

  /*Configure GPIO pin : ExtModTX_Pin */
  GPIO_InitStruct.Pin = ExtModTX_Pin;
  GPIO_InitStruct.Mode = GPIO_MODE_INPUT;
  GPIO_InitStruct.Pull = GPIO_NOPULL;
  HAL_GPIO_Init(ExtModTX_GPIO_Port, &GPIO_InitStruct);

  /*Configure GPIO pin : TelemDir_Pin */
  GPIO_InitStruct.Pin = TelemDir_Pin;
  GPIO_InitStruct.Mode = GPIO_MODE_OUTPUT_PP;
  GPIO_InitStruct.Pull = GPIO_NOPULL;
  GPIO_InitStruct.Speed = GPIO_SPEED_FREQ_LOW;
  HAL_GPIO_Init(TelemDir_GPIO_Port, &GPIO_InitStruct);

  /*Configure GPIO pin : BluetoothEn_Pin */
  GPIO_InitStruct.Pin = BluetoothEn_Pin;
  GPIO_InitStruct.Mode = GPIO_MODE_OUTPUT_PP;
  GPIO_InitStruct.Pull = GPIO_NOPULL;
  GPIO_InitStruct.Speed = GPIO_SPEED_FREQ_LOW;
  HAL_GPIO_Init(BluetoothEn_GPIO_Port, &GPIO_InitStruct);

  /*Configure GPIO pins : USBchaCtrl_Pin USBchgDetect_Pin */
  GPIO_InitStruct.Pin = USBchaCtrl_Pin|USBchgDetect_Pin;
  GPIO_InitStruct.Mode = GPIO_MODE_INPUT;
  GPIO_InitStruct.Pull = GPIO_NOPULL;
  HAL_GPIO_Init(GPIOG, &GPIO_InitStruct);

}

void Error_Handler(void)
{
  __disable_irq();
  while (1)
  {
  }
}

/************************ (C) COPYRIGHT STMicroelectronics *****END OF FILE****/
